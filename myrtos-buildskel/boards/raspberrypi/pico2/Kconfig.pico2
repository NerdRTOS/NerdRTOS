## myrtos-buildskel/boards/raspberrypi/pico2/Kconfig.pico2
```kconfig
config BOARD_PICO2_RP2350A_M33
    bool "Raspberry Pi Pico 2 (RP2350A, Cortex-M33)"
    select BOARD_PICO2
    select SOC_RP2350A_M33

config BOARD_PICO2_RP2350A_HAZARD3
    bool "Raspberry Pi Pico 2 (RP2350A, Hazard3 RISC-V)"
    select BOARD_PICO2
    select SOC_RP2350A_HAZARD3
```

## myrtos-buildskel/boards/raspberrypi/pico2/pico2_rp2350a_hazard3_defconfig
```kconfig
CONFIG_BOARD_PICO2_RP2350A_HAZARD3=y
CONFIG_PICO2_FLASH_SIZE_MB=4
CONFIG_RP2350_DUAL_CORE=y
```

## myrtos-buildskel/boards/raspberrypi/pico2/pico2_rp2350a_m33_defconfig
```kconfig
CONFIG_BOARD_PICO2_RP2350A_M33=y
CONFIG_PICO2_FLASH_SIZE_MB=4
CONFIG_RP2350_DUAL_CORE=y
```

## myrtos-buildskel/boards/st/nucleo_f429zi/Kconfig
```kconfig
if BOARD_NUCLEO_F429ZI

config BOARD
    string
    default "nucleo_f429zi"

config NUCLEO_USE_EXTERNAL_OSC
    bool "Use external HSE oscillator"
    default y

endif # BOARD_NUCLEO_F429ZI
```

## myrtos-buildskel/boards/st/nucleo_f429zi/Kconfig.nucleo_f429zi
```kconfig
config BOARD_NUCLEO_F429ZI
    bool "STM32 Nucleo-F429ZI"
    select SOC_STM32F4
```

## myrtos-buildskel/soc/qemu/cortex_a9/Kconfig
```kconfig
if SOC_QEMU_CORTEX_A9

config SOC_NAME
    string
    default "cortex_a9"

config QEMU_A9_NUM_CORES
    int "Number of simulated CPU cores"
    default 1
    help
      QEMU vexpress-a9 可以模拟多核，这里先固定演示单核，
      多核调度是内核层的事，不影响这一层的 Kconfig 结构。

endif # SOC_QEMU_CORTEX_A9
```

## myrtos-buildskel/soc/qemu/cortex_a9/Kconfig.defconfig
```kconfig
if SOC_QEMU_CORTEX_A9

config SYS_CLOCK_HW_CYCLES_PER_SEC
    int
    default 24000000

endif # SOC_QEMU_CORTEX_A9
```

## myrtos-buildskel/soc/qemu/cortex_a9/Kconfig.soc
```kconfig
config SOC_QEMU_CORTEX_A9
    bool
    select ARCH_ARM_CORTEX_A
    select CPU_HAS_FPU
```

## myrtos-buildskel/soc/raspberrypi/rp2350/Kconfig
```kconfig
if SOC_RP2350

config SOC
    string
    default "rp2350a" if SOC_RP2350A

config SOC_CPU_CLUSTER
    string
    default "m33" if SOC_RP2350A_M33
    default "hazard3" if SOC_RP2350A_HAZARD3

config RP2350_DUAL_CORE
    bool "Enable RP2350 second core support"
    default y

endif # SOC_RP2350
```

## myrtos-buildskel/soc/raspberrypi/rp2350/Kconfig.defconfig
```kconfig
if SOC_RP2350

config SYS_CLOCK_HW_CYCLES_PER_SEC
    int
    default 150000000

endif # SOC_RP2350
```

## myrtos-buildskel/soc/st/stm32f4/Kconfig
```kconfig
if SOC_STM32F4

config SOC_NAME
    string
    default "stm32f4"

config STM32F4_USE_HAL_DRIVER
    bool "Use ST HAL driver layer"
    default y

endif # SOC_STM32F4
```

## myrtos-buildskel/soc/st/stm32f4/Kconfig.defconfig
```kconfig
if SOC_STM32F4

config SYS_CLOCK_HW_CYCLES_PER_SEC
    int
    default 180000000

endif # SOC_STM32F4
```

## soc/qemu/cortex_a9/Kconfig
```kconfig
if SOC_QEMU_CORTEX_A9

config SOC
    string
    default "qemu_cortex_a9"

endif # SOC_QEMU_CORTEX_A9
```

## soc/raspberrypi/rp2350/Kconfig
```kconfig
if SOC_RP2350

config SOC
    string
    default "rp2350a" if SOC_RP2350A

config SOC_CPU_CLUSTER
    string
    default "m33" if SOC_RP2350A_M33
    default "hazard3" if SOC_RP2350A_HAZARD3

endif # SOC_RP2350
```

## soc/raspberrypi/rp2350/Kconfig.soc
```kconfig
config SOC_RP2350
    bool

config SOC_RP2350A
    bool
    select SOC_RP2350

config SOC_RP2350A_M33
    bool
    select SOC_RP2350A
    select ARCH_ARM_M33

config SOC_RP2350A_HAZARD3
    bool
    select SOC_RP2350A
    select ARCH_RISCV_RV32
```

## soc/st/stm32f1/Kconfig
```kconfig
if SOC_STM32F103

config SOC
    string
    default "stm32f103"

endif # SOC_STM32F103
```

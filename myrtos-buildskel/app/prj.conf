## CMakeLists.txt
```
add_executable(app src/main.c)
target_link_libraries(app PRIVATE board)
```

## Kconfig
```
config APP_LOG_LEVEL
    int "Application log level"
    default 3
    range 0 4
```

## prj.conf
```kconfig
CONFIG_NUM_PRIORITIES=32
CONFIG_APP_LOG_LEVEL=2
```

## boards/nucleo_f429zi.conf
```kconfig
CONFIG_APP_LOG_LEVEL=2
```

## boards/pico2_rp2350a_hazard3.conf
```kconfig
CONFIG_APP_LOG_LEVEL=4
```

## boards/pico2_rp2350a_m33.conf
```kconfig
CONFIG_APP_LOG_LEVEL=3
```

## boards/qemu_a9.conf
```kconfig
CONFIG_APP_LOG_LEVEL=1
```

## src/main.c
```c
#include <stdio.h>
#include "autoconf.h"
#include "devicetree_generated.h"
#include "soc.h"
#include "board.h"

int main(void)
{
    soc_init();
    board_init();

    printf("MyRTOS skeleton booted on board=%s, model=%s, sram=0x%X+0x%X, num_priorities=%d, app_log_level=%d\n",
           CONFIG_BOARD, DT_MODEL, DT_SRAM_BASE, DT_SRAM_SIZE,
           CONFIG_NUM_PRIORITIES, CONFIG_APP_LOG_LEVEL);

    return 0;
}
```

## CMakeLists.txt
```
# Zephyr-style QEMU shell sample application.
set(NERD_SAMPLE_SOURCES
    ${CMAKE_CURRENT_LIST_DIR}/src/app.c
    CACHE INTERNAL "Selected sample application sources"
)

set(NERD_SAMPLE_INCLUDE_DIRS
    ${CMAKE_CURRENT_LIST_DIR}/include
    CACHE INTERNAL "Selected sample application include directories"
)
```

## prj.conf
```kconfig
CONFIG_ND_NAME_MAX_SIZE=16
CONFIG_ND_IDLE_STACK_SIZE=512
CONFIG_ND_CFG_TICKLESS=y
CONFIG_ND_TICKS_PER_SEC=1000
# CONFIG_ND_CFG_DEBUG is not set
```

## boards/qemu_a9.conf
```kconfig
# Application overrides for BOARD=qemu_a9/cortex_a9.
# QEMU target keeps default kernel policy for now.
```

## include/app.h
```c
#ifndef __APP_H__
#define __APP_H__

#include "nerd.h"
#include "nd_shell.h"

void nd_app_init(void);

#endif
```

## src/app.c
```c
#include "app.h"

#define SHELL_STACK_SIZE        2048

static nd_thread_t shell;

ALIGN(8) static nd_uint8_t shell_stack[SHELL_STACK_SIZE];

void nd_app_init(void)
{
    shell_init();

    nd_thread_create(&shell, "shell", nd_shell_task_entry,
                    30, ND_NULL, shell_stack, sizeof(shell_stack), ND_THREAD_OPT_NONE, 0);
}
```

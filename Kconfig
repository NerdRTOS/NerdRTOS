## Kconfig
```kconfig
mainmenu "NerdRTOS Configuration"

menu "Legacy BSP Compatibility"

choice
    prompt "Target BSP (legacy)"
    default BSP_RASPI_PICO2

config BSP_RASPI_PICO2
    bool "Raspberry Pi Pico 2"

config BSP_VEXPRESS_A9_QEMU
    bool "VExpress A9 QEMU"

config BSP_STM32F103RCT6
    bool "STM32F103RCT6"

endchoice

endmenu

source "arch/Kconfig"
source "soc/Kconfig"
source "boards/Kconfig"

source "kernel/Kconfig"

source "bsp/raspi-pico2/Kconfig"
```

## arch/Kconfig
```kconfig
menu "Architecture"

config ARCH_ARM_M3
    bool "ARM Cortex-M3"
    help
        Build NerdRTOS for ARM Cortex-M3 targets. In the new hardware model,
        this is selected by the SoC/board target.

config ARCH_ARM_M33
    bool "ARM Cortex-M33"
    help
        Build NerdRTOS for ARM Cortex-M33 targets. Kept visible during the
        migration so existing defconfig files that assign CONFIG_ARCH_ARM_M33
        remain valid.

config ARCH_ARM_A9
    bool "ARM Cortex-A9"
    help
        Build NerdRTOS for ARM Cortex-A9 targets. In the new hardware model,
        this is selected by the SoC/board target.

config ARCH_RISCV_RV32
    bool "RISC-V RV32"
    help
        Build NerdRTOS for RISC-V RV32 targets. Kept visible during the
        migration so existing defconfig files that assign CONFIG_ARCH_RISCV_RV32
        remain valid.

comment "Legacy architecture defaults"

config LEGACY_DEFAULT_ARM_M33
    bool
    default y if BSP_RASPI_PICO2 && !ARCH_RISCV_RV32
    select ARCH_ARM_M33

endmenu
```

## boards/Kconfig
```kconfig
# Board hardware model entry point.
# During migration this is opt-in, so existing BSP defconfigs are not changed
# implicitly. New board-target defconfigs should set CONFIG_BOARD_TARGET_MODEL=y.

menu "Board Target Hardware Model"

config BOARD_TARGET_MODEL
    bool "Enable board-target hardware model"
    default n
    help
        Enables the new Zephyr-style board target model. This is opt-in during
        migration so legacy BSP configs continue to behave as before.

if BOARD_TARGET_MODEL

choice
    prompt "Board target"
    default BOARD_PICO2_RP2350A_M33 if BSP_RASPI_PICO2
    default BOARD_QEMU_A9 if BSP_VEXPRESS_A9_QEMU
    default BOARD_STM32F103RCT6_M3_ALIENTEK if BSP_STM32F103RCT6

source "boards/raspberrypi/pico2/Kconfig.pico2"
source "boards/qemu/qemu_a9/Kconfig.qemu_a9"
source "boards/st/stm32f103rct6_m3_alientek/Kconfig.stm32f103rct6_m3_alientek"

endchoice

source "boards/raspberrypi/pico2/Kconfig"
source "boards/qemu/qemu_a9/Kconfig"
source "boards/st/stm32f103rct6_m3_alientek/Kconfig"

endif # BOARD_TARGET_MODEL

endmenu
```

## boards/qemu/qemu_a9/Kconfig
```kconfig
if BOARD_QEMU_A9

config BOARD
    string
    default "qemu_a9/cortex_a9"

endif # BOARD_QEMU_A9
```

## boards/qemu/qemu_a9/Kconfig.qemu_a9
```kconfig
config BOARD_QEMU_A9
    bool "QEMU VExpress Cortex-A9"
    select SOC_QEMU_CORTEX_A9
```

## boards/qemu/qemu_a9/qemu_a9_defconfig
```kconfig
CONFIG_BSP_VEXPRESS_A9_QEMU=y
CONFIG_BOARD_TARGET_MODEL=y
CONFIG_BOARD_QEMU_A9=y
```

## boards/raspberrypi/pico2/Kconfig
```kconfig
config BOARD_PICO2
    bool

if BOARD_PICO2

config BOARD
    string
    default "pico2/rp2350a/m33" if BOARD_PICO2_RP2350A_M33
    default "pico2/rp2350a/hazard3" if BOARD_PICO2_RP2350A_HAZARD3

endif # BOARD_PICO2
```

## boards/raspberrypi/pico2/pico2_rp2350a_m33_defconfig
```kconfig
CONFIG_BSP_RASPI_PICO2=y
CONFIG_BOARD_TARGET_MODEL=y
CONFIG_BOARD_PICO2_RP2350A_M33=y
CONFIG_ND_CPU_CLOCK_HZ=150000000
CONFIG_ND_TICKLESS_FREQ=1000000
```

## boards/st/stm32f103rct6_m3_alientek/Kconfig
```kconfig
if BOARD_STM32F103RCT6_M3_ALIENTEK

config BOARD
    string
    default "stm32f103rct6/m3"

endif # BOARD_STM32F103RCT6_M3_ALIENTEK
```

## boards/st/stm32f103rct6_m3_alientek/Kconfig.stm32f103rct6_m3_alientek
```kconfig
config BOARD_STM32F103RCT6_M3_ALIENTEK
    bool "ALIENTEK STM32F103RCT6 Cortex-M3"
    select SOC_STM32F103
```

## boards/st/stm32f103rct6_m3_alientek/stm32f103rct6_m3_alientek_defconfig
```kconfig
CONFIG_BSP_STM32F103RCT6=y
CONFIG_BOARD_TARGET_MODEL=y
CONFIG_BOARD_STM32F103RCT6_M3_ALIENTEK=y
```

## bsp/raspi-pico2/Kconfig
```kconfig
if BSP_RASPI_PICO2

menu "Raspberry Pi Pico 2 BSP"

config ND_CPU_CLOCK_HZ
    int "CPU clock frequency"
    default 150000000
    help
        CPU clock frequency in Hz.

endmenu

endif
```

## configs/pico2_defconfig
```kconfig
CONFIG_BSP_RASPI_PICO2=y
CONFIG_ARCH_ARM_M33=y
CONFIG_ND_CPU_CLOCK_HZ=150000000
CONFIG_ND_NAME_MAX_SIZE=16
CONFIG_ND_TICKLESS_FREQ=1000000
CONFIG_ND_TICKS_PER_SEC=1000
CONFIG_ND_IDLE_STACK_SIZE=512
CONFIG_ND_CFG_TICKLESS=y
# CONFIG_ND_CFG_DEBUG is not set
```

## kernel/Kconfig
```kconfig
menu "Kernel"

config ND_NAME_MAX_SIZE
    int "Kernel object name max size"
    default 16
    help
        Maximum size of kernel object names.

config ND_IDLE_STACK_SIZE
    int "Idle thread stack size"
    default 512
    help
        Stack size used by the idle thread.

menu "Timer"

config ND_CFG_TICKLESS
    bool "Enable tickless timer"
    default y
    help
        Use the high-resolution hardware timer path instead of periodic ticks.

config ND_TICKLESS_FREQ
    int "Tickless timer frequency"
    default 1000000
    depends on ND_CFG_TICKLESS
    help
        High-resolution timer frequency used by tickless mode.

config ND_TICKS_PER_SEC
    int "System ticks per second"
    default 1000
    help
        Periodic system tick rate.

endmenu

menu "Debug"

config ND_CFG_DEBUG
    bool "Enable debug checks"
    default n
    help
        Enable debug assertions and memory heap magic checks.

endmenu

endmenu
```

## myrtos-buildskel/Kconfig
```kconfig
mainmenu "MyRTOS Project Configuration"

# 1) 选板子 -> 板子 select 对应 SoC -> SoC select 对应架构
#    这一条 select 链就是整个平台层的骨架
source "boards/Kconfig"
source "soc/Kconfig"
source "arch/Kconfig"

menu "Kernel"

config NUM_PRIORITIES
    int "Number of thread priorities"
    default 32
    help
      线程优先级数量，跟具体板子/架构无关，属于内核层配置，
      所以直接写在顶层 Kconfig 里，不需要下放到 arch/soc/board。

endmenu

menu "Application"
    # osource: 文件不存在也不报错，方便每个 app 自己决定要不要提供 Kconfig
    osource "$(APP_DIR)/Kconfig"
endmenu
```

## myrtos-buildskel/arch/arm_cortex_a/Kconfig
```kconfig
if ARCH_ARM_CORTEX_A

config ARCH
    string
    default "arm_cortex_a"

config MMU
    bool "Enable MMU support"
    default y

endif # ARCH_ARM_CORTEX_A
```

## myrtos-buildskel/arch/arm_cortex_m/Kconfig
```kconfig
if ARCH_ARM_CORTEX_M

config ARCH
    string
    default "arm_cortex_m"

endif # ARCH_ARM_CORTEX_M
```

## myrtos-buildskel/boards/qemu/qemu_a9/Kconfig
```kconfig
if BOARD_QEMU_A9

config BOARD
    string
    default "qemu_a9"

config QEMU_A9_RAM_SIZE_MB
    int "Simulated RAM size (MB)"
    default 128

endif # BOARD_QEMU_A9
```

## myrtos-buildskel/boards/qemu/qemu_a9/Kconfig.qemu_a9
```kconfig
config BOARD_QEMU_A9
    bool "QEMU Cortex-A9 (vexpress-a9)"
    select SOC_QEMU_CORTEX_A9
```

## myrtos-buildskel/boards/raspberrypi/pico2/Kconfig
```kconfig
config BOARD_PICO2
    bool

if BOARD_PICO2

config BOARD
    string
    default "pico2/rp2350a/m33" if BOARD_PICO2_RP2350A_M33
    default "pico2/rp2350a/hazard3" if BOARD_PICO2_RP2350A_HAZARD3

config PICO2_FLASH_SIZE_MB
    int "Onboard flash size (MB)"
    default 4

endif # BOARD_PICO2
```
